## boards/shields/dongle_display/Kconfig.defconfig
```kconfig
# Copyright (c) 2024 The ZMK Contributors
# SPDX-License-Identifier: MIT

if SHIELD_DONGLE_DISPLAY

config I2C
    default y

config SSD1306
    default y

config DONGLE_DISPLAY_ORIGINAL_WIDTH
    int
    default 128

config DONGLE_DISPLAY_ORIGINAL_HEIGHT
    int
    default 32
    
choice ZMK_DISPLAY_STATUS_SCREEN
    default ZMK_DISPLAY_STATUS_SCREEN_CUSTOM
endchoice

choice ZMK_DISPLAY_WORK_QUEUE
    default ZMK_DISPLAY_WORK_QUEUE_DEDICATED
endchoice

config LV_Z_MEM_POOL_SIZE
    default 8192

config LV_Z_VDB_SIZE
    default 64

config LV_DPI_DEF
    default 148

config LV_Z_BITS_PER_PIXEL
    default 1

choice LV_COLOR_DEPTH
    default LV_COLOR_DEPTH_1
endchoice

config ZMK_DISPLAY_STATUS_SCREEN_CUSTOM
    select LV_USE_LABEL
    select LV_USE_IMG
    select LV_USE_CANVAS
    select LV_USE_ANIMIMG 
    select LV_USE_ANIMATION
    select LV_USE_LINE 

config DONGLE_DISPLAY_ROTATE
    bool "rotate widgets on display"
    default y

config DONGLE_DISPLAY_FLIP
    bool "flips display orientation"
    default n

config DONGLE_DISPLAY_INVERT
    bool "y is black on white / n is white on black"
    default n


endif
```

## boards/shields/oled_adapter/Kconfig.defconfig
```kconfig
if SHIELD_OLED_128X32_PROMICRO

config DONGLE_DISPLAY_ORIGINAL_WIDTH
    int
    default 128

config DONGLE_DISPLAY_ORIGINAL_HEIGHT
    int
    default 32

if ZMK_DISPLAY

config I2C
    default y

config SSD1306
    default y

endif # ZMK_DISPLAY

endif
```

## boards/shields/oled_adapter/Kconfig.shield
```kconfig
# Copyright (c) 2024 The ZMK Contributors
# SPDX-License-Identifier: MIT

config SHIELD_OLED_128X32_PROMICRO
    def_bool $(shields_list_contains,oled_128x32_promicro)
```

## config/west.yml
```yaml
manifest:
  remotes:
    - name: zmkfirmware
      url-base: https://github.com/zmkfirmware
    - name: danielelombardo
      url-base: https://github.com/danielelombardo
  projects:
    - name: zmk
      remote: zmkfirmware
      revision: main
      import: app/west.yml
    - name: zmk-config-keyb
      remote: danielelombardo
      revision: main
  self:
    path: config
```
